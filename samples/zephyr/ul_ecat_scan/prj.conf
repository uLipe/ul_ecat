## CMakeLists.txt
```
# SPDX-License-Identifier: MIT
#
# Build from this directory with the ul_ecat repo registered as a Zephyr module, e.g.:
#   export ZEPHYR_EXTRA_MODULES=/path/to/ul_ecat
#   west build -b native_sim/native/64 -- -DZEPHYR_EXTRA_MODULES=/path/to/ul_ecat
#
# Or prepend the repo root to ZEPHYR_EXTRA_MODULES from this sample (three levels up):
cmake_minimum_required(VERSION 3.20)

set(UL_ECAT_REPO_ROOT "${CMAKE_CURRENT_SOURCE_DIR}/../../..")
list(APPEND ZEPHYR_EXTRA_MODULES ${UL_ECAT_REPO_ROOT})

find_package(Zephyr REQUIRED HINTS $ENV{ZEPHYR_BASE})
project(ul_ecat_scan)

target_sources(app PRIVATE src/main.c)
```

## prj.conf
```kconfig
# ul_ecat scan sample — reference board: native_sim (see doc/zephyr-module.md)

CONFIG_MAIN_STACK_SIZE=4096
CONFIG_SYSTEM_WORKQUEUE_STACK_SIZE=2048

CONFIG_PRINTK=y
CONFIG_LOG=y
CONFIG_LOG_MODE_MINIMAL=y

# Networking (aligned with Zephyr samples/net/sockets/packet)
CONFIG_NETWORKING=y
CONFIG_NET_UDP=n
CONFIG_NET_TCP=n
CONFIG_NET_IPV6=n
CONFIG_NET_IPV4=n
CONFIG_NET_MAX_CONTEXTS=10
CONFIG_NET_SOCKETS=y
CONFIG_POSIX_API=y
CONFIG_NET_CONTEXT_RCVTIMEO=y
CONFIG_NET_MGMT=y
CONFIG_NET_MGMT_EVENT=y

CONFIG_NET_SOCKETS_PACKET=y

CONFIG_ENTROPY_GENERATOR=y
CONFIG_TEST_RANDOM_GENERATOR=y

CONFIG_NET_PKT_RX_COUNT=16
CONFIG_NET_PKT_TX_COUNT=16
CONFIG_NET_BUF_RX_COUNT=64
CONFIG_NET_BUF_TX_COUNT=64
CONFIG_NET_CONTEXT_NET_PKT_POOL=y

# ul_ecat module
CONFIG_UL_ECAT=y
CONFIG_UL_ECAT_MASTER=y

# Ethernet: native_sim host tap; adjust for your board
CONFIG_NET_L2_ETHERNET=y
CONFIG_ETH_DRIVER=y
CONFIG_ETH_NATIVE_POSIX=y
```

## src/main.c
```c
/*
 * Copyright (c) ul_ecat contributors
 * SPDX-License-Identifier: MIT
 *
 * Scan the EtherCAT bus and print discovered slaves (printk).
 */

#include <string.h>

#include <zephyr/kernel.h>
#include <zephyr/sys/printk.h>

#include "ul_ecat_master.h"

/* Set at build time if needed: -DUL_ECAT_SAMPLE_IFACE_NAME=\"eth1\" */
#ifndef UL_ECAT_SAMPLE_IFACE_NAME
#define UL_ECAT_SAMPLE_IFACE_NAME "eth0"
#endif

int main(void)
{
	static const char iface[] = UL_ECAT_SAMPLE_IFACE_NAME;

	printk("ul_ecat_scan: interface \"%s\"\n", iface);

	ul_ecat_master_settings_t cfg = {
		.iface_name = iface,
		.dst_mac = {0},
		.src_mac = {0x02, 0x00, 0x00, 0x00, 0x00, 0x01},
		.rt_priority = 0,
		.dc_enable = 0,
		.dc_sync0_cycle = 1000000u,
	};

	ul_ecat_mac_broadcast(cfg.dst_mac);

	if (ul_ecat_master_init(&cfg) != 0) {
		printk("ul_ecat_scan: ul_ecat_master_init failed\n");
		return 0;
	}

	(void)ul_ecat_scan_network();

	ul_ecat_master_slaves_t *db = ul_ecat_get_master_slaves();

	printk("ul_ecat_scan: %d slave(s)\n", db->slave_count);
	for (int i = 0; i < db->slave_count; i++) {
		const ul_ecat_slave_t *sl = &db->slaves[i];

		printk("  [%d] station=0x%04X vendor=0x%08X product=0x%08X rev=0x%08X ser=0x%08X\n", i,
		       sl->station_address, sl->vendor_id, sl->product_code, sl->revision_no,
		       sl->serial_no);
	}

	(void)ul_ecat_master_shutdown();
	return 0;
}
```
