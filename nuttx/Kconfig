## nuttx/Kconfig
```kconfig
# Copyright (c) ul_ecat contributors
# SPDX-License-Identifier: MIT
#
# Include from apps/Kconfig, e.g.:
#   source "/path/to/ul_ecat/nuttx/Kconfig"

config UL_ECAT
	bool "ul_ecat EtherCAT libraries (master and/or slave)"
	default n
	help
	  EtherCAT master (raw L2) and/or slave ESC + LAN9252 SPI stack.

config UL_ECAT_MASTER
	bool "EtherCAT master core (scan, queue, DC)"
	default n
	depends on UL_ECAT && NET
	select NET_PKT
	help
	  Raw packet (AF_PACKET) path for EtherCAT ethertype 0x88A4.
	  Requires CONFIG_NET_PKT (packet sockets); see doc/nuttx-module.md for defconfig hints.

config UL_ECAT_SLAVE
	bool "EtherCAT slave + LAN9252 (SPI)"
	default n
	depends on UL_ECAT
	select SPI
	help
	  ESC mirror, PDU handling, LAN9252 driver + NuttX SPI HAL (ports/lan9252/nuttx/hal_nuttx.c).
	  Enable your board SPI driver (e.g. CONFIG_STM32_SPI1 / SPI0) in defconfig.
```

## samples/nuttx/ul_ecat_scan/Kconfig
```kconfig
# Copyright (c) ul_ecat contributors
# SPDX-License-Identifier: MIT
#
# Add to nuttx-apps Kconfig (e.g. apps/Kconfig) before this line:
#   source "/absolute/path/to/ul_ecat/nuttx/Kconfig"

config EXAMPLES_UL_ECAT_SCAN
	bool "ul_ecat EtherCAT bus scan example"
	default n
	depends on UL_ECAT_MASTER
	---help---
	  Scans the EtherCAT network and prints discovered slaves to stdout.
	  Set UL_ECAT_ROOT in the application Makefile to the ul_ecat repository path.
```

## samples/nuttx/ul_ecat_servo/Kconfig
```kconfig
# Copyright (c) ul_ecat contributors
# SPDX-License-Identifier: MIT
#
# Add to nuttx-apps Kconfig (with nuttx/Kconfig sourced):
#   source "/path/to/ul_ecat/samples/nuttx/ul_ecat_servo/Kconfig"

config EXAMPLES_UL_ECAT_SERVO
	bool "ul_ecat EtherCAT slave + LAN9252 servo PDO example"
	default n
	depends on UL_ECAT_SLAVE
	---help---
	  LAN9252 SPI (SPI0 via board_ul_ecat_lan9252_spi0) and fictitious CiA402-style PDO.
	  Enable SPI in defconfig (CONFIG_SPI=y and your SoC SPI driver).
```

## zephyr/Kconfig
```kconfig
# Copyright (c) ul_ecat contributors
# SPDX-License-Identifier: MIT

config UL_ECAT
	bool "ul_ecat EtherCAT libraries"
	help
	  Minimal EtherCAT master and/or slave stacks. Enable UL_ECAT_MASTER
	  for L2 master (needs networking) and/or UL_ECAT_SLAVE for ESC + LAN9252.

if UL_ECAT

config UL_ECAT_MASTER
	bool "EtherCAT master (scan, queue, DC)"
	depends on NETWORKING
	select NET_SOCKETS
	select NET_SOCKETS_PACKET
	imply NET_IPV4
	imply NET_IPV6
	imply NET_SOCKETS_POSIX_NAMES
	help
	  Requires CONFIG_NET_SOCKETS_PACKET for raw EtherCAT (ethertype 0x88A4).

config UL_ECAT_TRANSPORT_NETDEV
	bool "TX frames via net_if (net_pkt) instead of socket send"
	depends on UL_ECAT_MASTER
	help
	  Sends built Ethernet frames with net_if_queue_tx() for direct driver TX.
	  RX and timing still use the packet socket on the same interface.

config UL_ECAT_SLAVE
	bool "EtherCAT slave (ESC mirror, PDU, LAN9252 controller)"
	select SPI
	help
	  Software ESC mirror, datagram handling, and optional LAN9252 SPI backend.

config UL_ECAT_LAN9252_HAL
	bool "LAN9252 Zephyr SPI HAL (/chosen ul-ecat-spi, SYS_INIT)"
	depends on UL_ECAT_SLAVE
	default y
	select SPI
	help
	  Strong HAL using devicetree /chosen ul-ecat-spi -> SPI device node.
	  Requires GPIO CS on the SPI node; CS is driven manually for LAN9252
	  register sequences. Enables CONFIG_SPI.

endif # UL_ECAT
```
